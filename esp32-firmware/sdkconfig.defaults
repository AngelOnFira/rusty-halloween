## esp32-firmware/sdkconfig.defaults
```kconfig
# Rust often needs a bit of an extra main task stack size compared to C (the default is 3K)
CONFIG_ESP_MAIN_TASK_STACK_SIZE=8000

# Use this to set FreeRTOS kernel tick frequency to 1000 Hz (100 Hz by default).
# This allows to use 1 ms granularity for thread sleeps (10 ms by default).
#CONFIG_FREERTOS_HZ=1000

# Enable minimal Mozilla CA certificate bundle for HTTPS connections
# Uses common certificates only (~15-20KB vs 50-70KB for full bundle)
# Includes DigiCert root CA (used by Cloudflare and GitHub)
# TODO: Switch to custom bundle (certs/bundle.pem) to save ~15KB flash
CONFIG_MBEDTLS_CERTIFICATE_BUNDLE=y
CONFIG_MBEDTLS_CERTIFICATE_BUNDLE_DEFAULT_CMN=y

# TLS buffer sizes - CRITICAL: Must fit in internal RAM (not PSRAM)
# mbedtls crypto operations fail with PSRAM buffers due to DMA/cache issues
# Optimized sizes for stability:
# - 6KB RX: Handles larger TLS records (some can be >4KB)
# - 2KB TX: Sufficient for HTTP GET requests
# Total: 8KB (down from 12KB, balanced between stability and RAM usage)
# These will be forced to internal RAM via SPIRAM_MALLOC_ALWAYSINTERNAL=8192 below
CONFIG_MBEDTLS_SSL_IN_CONTENT_LEN=6144
CONFIG_MBEDTLS_SSL_OUT_CONTENT_LEN=2048

# OTA Configuration
CONFIG_PARTITION_TABLE_CUSTOM=y
CONFIG_PARTITION_TABLE_CUSTOM_FILENAME="../../../../../../partitions.csv"
CONFIG_PARTITION_TABLE_FILENAME="../../../../../../partitions.csv"

# Flash size configuration (ESP32-S2-DEVKITC-1R has 4MB)
CONFIG_ESPTOOLPY_FLASHSIZE_4MB=y
CONFIG_ESPTOOLPY_FLASHSIZE="4MB"

# Enable OTA rollback functionality
CONFIG_BOOTLOADER_APP_ROLLBACK_ENABLE=y
CONFIG_BOOTLOADER_APP_ANTI_ROLLBACK=n

# Rollback timeout (revert to previous firmware if not marked valid within 30 seconds)
CONFIG_BOOTLOADER_APP_ROLLBACK_TIMEOUT_SECONDS=30

# HTTP client buffer size for OTA downloads
CONFIG_ESP_HTTP_CLIENT_BUFFER_SIZE=4096

# DHCP and Network Debug Logging
CONFIG_LOG_DEFAULT_LEVEL_DEBUG=y
CONFIG_LWIP_DHCP_DEBUG=y
CONFIG_ESP_NETIF_DEBUG=y
CONFIG_LOG_MAXIMUM_LEVEL_DEBUG=y

# PSRAM Configuration (ESP32-S2 has 2MB external PSRAM)
# This dramatically increases available heap memory
CONFIG_ESP32S2_SPIRAM_SUPPORT=y
CONFIG_SPIRAM=y
CONFIG_SPIRAM_MODE_QUAD=y
CONFIG_SPIRAM_TYPE_AUTO=y
CONFIG_SPIRAM_SIZE=2097152

# Add PSRAM to heap allocator
CONFIG_SPIRAM_USE_CAPS_ALLOC=y
CONFIG_SPIRAM_USE_MALLOC=y

# Allow malloc() to use PSRAM when internal memory is full
CONFIG_SPIRAM_MEMTEST=y
# Force allocations <= 8KB to internal RAM
# This ensures WiFi control structures AND TLS buffers stay in internal RAM
# - WiFi DMA buffers: must be in internal RAM
# - TLS buffers (4KB RX + 2KB TX = 6KB): must be in internal RAM due to crypto DMA
# Setting to 8KB gives headroom for TLS working buffers
CONFIG_SPIRAM_MALLOC_ALWAYSINTERNAL=8192
# Reserve 140KB of internal RAM for WiFi/Mesh/TLS/DMA operations
# WiFi needs ~62KB + Mesh needs ~43KB + TLS needs ~6KB + safety margin = ~140KB
CONFIG_SPIRAM_MALLOC_RESERVE_INTERNAL=143360

# WiFi Buffer Configuration
# CRITICAL: WiFi buffers are DMA buffers and MUST be in internal RAM
# They cannot be placed in PSRAM due to hardware DMA controller limitations
# Using reduced buffer counts to save internal RAM while maintaining stability
CONFIG_ESP_WIFI_STATIC_RX_BUFFER_NUM=8
CONFIG_ESP_WIFI_DYNAMIC_RX_BUFFER_NUM=8
CONFIG_ESP_WIFI_DYNAMIC_TX_BUFFER_NUM=8
CONFIG_ESP_WIFI_RX_BA_WIN=6
CONFIG_ESP_WIFI_TX_BA_WIN=6

# DO NOT allocate WiFi/LWIP buffers from PSRAM
# WiFi DMA operations require internal SRAM access
# Enabling this causes WiFi handshake failures
CONFIG_SPIRAM_TRY_ALLOCATE_WIFI_LWIP=n
```
